## build/Kconfig/Kconfig.modules
```kconfig
menu "zmk-pmw3610-driver (D:/Keyboard firmware/zmk-config-charybdis-pro/zmk-pmw3610-driver)"
osource "D:/Keyboard firmware/zmk-config-charybdis-pro/zmk-pmw3610-driver/Kconfig"
config ZEPHYR_ZMK_PMW3610_DRIVER_MODULE
	bool
	default y
endmenu
menu "acpica (D:/Keyboard firmware/zmk-config-charybdis-pro/modules/lib/acpica)"
osource "$(ZEPHYR_ACPICA_KCONFIG)"
config ZEPHYR_ACPICA_MODULE
	bool
	default y
endmenu
menu "canopennode (D:/Keyboard firmware/zmk-config-charybdis-pro/modules/lib/canopennode)"
osource "$(ZEPHYR_CANOPENNODE_KCONFIG)"
config ZEPHYR_CANOPENNODE_MODULE
	bool
	default y
endmenu
menu "cmsis (D:/Keyboard firmware/zmk-config-charybdis-pro/modules/hal/cmsis)"
osource "$(ZEPHYR_CMSIS_KCONFIG)"
config ZEPHYR_CMSIS_MODULE
	bool
	default y
endmenu
menu "cmsis-dsp (D:/Keyboard firmware/zmk-config-charybdis-pro/modules/lib/cmsis-dsp)"
osource "$(ZEPHYR_CMSIS_DSP_KCONFIG)"
config ZEPHYR_CMSIS_DSP_MODULE
	bool
	default y
endmenu
menu "cmsis-nn (D:/Keyboard firmware/zmk-config-charybdis-pro/modules/lib/cmsis-nn)"
osource "$(ZEPHYR_CMSIS_NN_KCONFIG)"
config ZEPHYR_CMSIS_NN_MODULE
	bool
	default y
endmenu
menu "fatfs (D:/Keyboard firmware/zmk-config-charybdis-pro/modules/fs/fatfs)"
osource "$(ZEPHYR_FATFS_KCONFIG)"
config ZEPHYR_FATFS_MODULE
	bool
	default y
endmenu
menu "hal_ambiq (D:/Keyboard firmware/zmk-config-charybdis-pro/modules/hal/ambiq)"
osource "$(ZEPHYR_HAL_AMBIQ_KCONFIG)"
config ZEPHYR_HAL_AMBIQ_MODULE
	bool
	default y
endmenu
menu "hal_espressif (D:/Keyboard firmware/zmk-config-charybdis-pro/modules/hal/espressif)"
osource "D:/Keyboard firmware/zmk-config-charybdis-pro/modules/hal/espressif/zephyr/Kconfig"
config ZEPHYR_HAL_ESPRESSIF_MODULE
	bool
	default y
endmenu
menu "hal_ethos_u (D:/Keyboard firmware/zmk-config-charybdis-pro/modules/hal/ethos_u)"
osource "$(ZEPHYR_HAL_ETHOS_U_KCONFIG)"
config ZEPHYR_HAL_ETHOS_U_MODULE
	bool
	default y
endmenu
menu "hal_gigadevice (D:/Keyboard firmware/zmk-config-charybdis-pro/modules/hal/gigadevice)"
osource "$(ZEPHYR_HAL_GIGADEVICE_KCONFIG)"
config ZEPHYR_HAL_GIGADEVICE_MODULE
	bool
	default y
endmenu
menu "hal_nordic (D:/Keyboard firmware/zmk-config-charybdis-pro/modules/hal/nordic)"
osource "$(ZEPHYR_HAL_NORDIC_KCONFIG)"
config ZEPHYR_HAL_NORDIC_MODULE
	bool
	default y
endmenu
menu "hal_rpi_pico (D:/Keyboard firmware/zmk-config-charybdis-pro/modules/hal/rpi_pico)"
osource "$(ZEPHYR_HAL_RPI_PICO_KCONFIG)"
config ZEPHYR_HAL_RPI_PICO_MODULE
	bool
	default y
endmenu
menu "hal_telink (D:/Keyboard firmware/zmk-config-charybdis-pro/modules/hal/telink)"
osource "D:/Keyboard firmware/zmk-config-charybdis-pro/modules/hal/telink/Kconfig"
config ZEPHYR_HAL_TELINK_MODULE
	bool
	default y
endmenu
menu "liblc3 (D:/Keyboard firmware/zmk-config-charybdis-pro/modules/lib/liblc3)"
osource "$(ZEPHYR_LIBLC3_KCONFIG)"
config ZEPHYR_LIBLC3_MODULE
	bool
	default y
endmenu
menu "littlefs (D:/Keyboard firmware/zmk-config-charybdis-pro/modules/fs/littlefs)"
osource "$(ZEPHYR_LITTLEFS_KCONFIG)"
config ZEPHYR_LITTLEFS_MODULE
	bool
	default y
endmenu
menu "lvgl (D:/Keyboard firmware/zmk-config-charybdis-pro/modules/lib/gui/lvgl)"
osource "D:/Keyboard firmware/zmk-config-charybdis-pro/modules/lib/gui/lvgl/Kconfig"
config ZEPHYR_LVGL_MODULE
	bool
	default y
endmenu
menu "mbedtls (D:/Keyboard firmware/zmk-config-charybdis-pro/modules/crypto/mbedtls)"
osource "$(ZEPHYR_MBEDTLS_KCONFIG)"
config ZEPHYR_MBEDTLS_MODULE
	bool
	default y
endmenu
menu "percepio (D:/Keyboard firmware/zmk-config-charybdis-pro/modules/debug/percepio)"
osource "D:/Keyboard firmware/zmk-config-charybdis-pro/modules/debug/percepio/zephyr/Kconfig"
config ZEPHYR_PERCEPIO_MODULE
	bool
	default y
endmenu
menu "picolibc (D:/Keyboard firmware/zmk-config-charybdis-pro/modules/lib/picolibc)"
osource "D:/Keyboard firmware/zmk-config-charybdis-pro/modules/lib/picolibc/zephyr/Kconfig"
config ZEPHYR_PICOLIBC_MODULE
	bool
	default y
endmenu
menu "segger (D:/Keyboard firmware/zmk-config-charybdis-pro/modules/debug/segger)"
osource "$(ZEPHYR_SEGGER_KCONFIG)"
config ZEPHYR_SEGGER_MODULE
	bool
	default y
endmenu
menu "trusted-firmware-a (D:/Keyboard firmware/zmk-config-charybdis-pro/modules/tee/tf-a/trusted-firmware-a)"
osource "$(ZEPHYR_TRUSTED_FIRMWARE_A_KCONFIG)"
config ZEPHYR_TRUSTED_FIRMWARE_A_MODULE
	bool
	default y
endmenu
menu "uoscore-uedhoc (D:/Keyboard firmware/zmk-config-charybdis-pro/modules/lib/uoscore-uedhoc)"
osource "$(ZEPHYR_UOSCORE_UEDHOC_KCONFIG)"
config ZEPHYR_UOSCORE_UEDHOC_MODULE
	bool
	default y
endmenu
menu "zcbor (D:/Keyboard firmware/zmk-config-charybdis-pro/modules/lib/zcbor)"
osource "$(ZEPHYR_ZCBOR_KCONFIG)"
config ZEPHYR_ZCBOR_MODULE
	bool
	default y
endmenu
menu "module (D:/Keyboard firmware/zmk-config-charybdis-pro/zmk/app/module)"
osource "D:/Keyboard firmware/zmk-config-charybdis-pro/zmk/app/module/Kconfig"
config ZEPHYR_MODULE_MODULE
	bool
	default y
endmenu
menu "prosepector-zmk-module (D:/Keyboard firmware/zmk-config-charybdis-pro/modules/prospector_adapter)"
osource "D:/Keyboard firmware/zmk-config-charybdis-pro/modules/prospector_adapter/Kconfig"
config ZEPHYR_PROSEPECTOR_ZMK_MODULE_MODULE
	bool
	default y
endmenu
```

## config/west.yml
```yaml
manifest:
  remotes:
    - name: zmkfirmware
      url-base: https://github.com/petejohanson
    - name: inorichi
      url-base: https://github.com/inorichi
    - name: carrefinho                            # <--- add this
      url-base: https://github.com/carrefinho     # <--- and this
  projects:
    - name: zmk
      remote: zmkfirmware
      revision: feat/pointers-move-scroll
      import: app/west.yml
    - name: zmk-pmw3610-driver
      remote: inorichi
      revision: main
    - name: prospector-zmk-module                 # <--- and these
      remote: carrefinho                          # <---
      revision: main                              # <---
      path: modules/prospector_adapter
  self:
    path: config
```
